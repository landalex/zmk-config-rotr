## config/boards/arm/rotr/Kconfig
```kconfig
# SPDX-License-Identifier: MIT

config BOARD_ENABLE_DCDC
	bool "Enable DCDC mode"
	select SOC_DCDC_NRF52X
	default y
	depends on BOARD_ROTR

config CONFIG_BT_CTLR_PHY_2M_SUPPORT
	bool
```

## config/boards/arm/rotr/Kconfig.defconfig
```kconfig
# ROTR board configuration

# Copyright (c) 2021 Polarity Works
# SPDX-License-Identifier: MIT

if BOARD_ROTR

config BOARD
	default "rotr"

if USB

config USB_NRFX
	default y

config USB_DEVICE_STACK
	default y

endif # USB

config BT_CTLR
	default BT

config ZMK_BLE
	default y

config ZMK_USB
	default y

config ZMK_BATTERY_VOLTAGE_DIVIDER
	default y

config ZMK_KEYBOARD_NAME
	default "ROTR"

config CONFIG_BT_CTLR_PHY_2M_SUPPORT
	default n

endif # BOARD_ROTR
```

## config/west.yml
```yaml
manifest:
  remotes:
    - name: zmkfirmware
      url-base: https://github.com/zmkfirmware
    - name: refil
      url-base: https://github.com/refil
    - name: ftc
      url-base: https://github.com/ftc
  projects:
    - name: zmk
      remote: refil
      revision: rotrlayer
      import: app/west.yml
    - name: zmk
      remote: ftc
      revision: mouse-ftc
      import: app/west.yml
  self:
    path: config
```
